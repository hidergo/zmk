## app/boards/arm/hidergo_dcmk1/Kconfig.board
```kconfig
# hid:ergo Disconnect MK1 board configuration

# Copyright (c) 2023 hid:ergo
# SPDX-License-Identifier: MIT

config BOARD_HIDERGO_DCMK1_LEFT
	bool "hidergo_dcmk1"
	depends on SOC_NRF52833_QIAA

config BOARD_HIDERGO_DCMK1_RIGHT
	bool "hidergo_dcmk1"
	depends on SOC_NRF52833_QIAA
```

## app/boards/arm/hidergo_dcmk1/Kconfig.defconfig
```kconfig
# Copyright (c) 2021 The ZMK Contributors
# SPDX-License-Identifier: MIT

if BOARD_HIDERGO_DCMK1_LEFT || BOARD_HIDERGO_DCMK1_RIGHT

config BOARD
	default "hidergo_dcmk1"

config ZMK_KEYBOARD_NAME
	default "Disconnect MK1"

config USB_NRFX
	default y

config SPI
	default y

config IL0323
	bool
	default y

# Enable UART driver, needed for CDC ACM
config USB_CDC_ACM
	default y

config BT_CTLR
	default BT

config ZMK_BLE
	default y

config ZMK_USB
	default y

# FOR DEBUGGING
config ZMK_LOG_LEVEL
	int
	default 1

# FOR DEBUGGING
config DISPLAY_LOG_LEVEL
	int
	default 1

config BT_PERIPHERAL_PREF_LATENCY
	default 15

endif # BOARD_HIDERGO_DCMK1_LEFT || BOARD_HIDERGO_DCMK1_RIGHT
```

## app/drivers/epd/Kconfig.il0323n
```kconfig
config IL0323N
	bool "IL0323 driver to use with HDL"
	depends on SPI
	depends on HEAP_MEM_POOL_SIZE != 0
	help
	  IL0323 driver to use with HDL.
```
